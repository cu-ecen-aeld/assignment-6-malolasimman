## nographic/conf/bblayers.conf
```bitbake
# POKY_BBLAYERS_CONF_VERSION is increased each time build/conf/bblayers.conf
# changes incompatibly
POKY_BBLAYERS_CONF_VERSION = "2"

BBPATH = "${TOPDIR}"
BBFILES ?= ""

BBLAYERS ?= " \
  /home/masr4788/aesd_assignments/A6_2/assignment-6-malolasimman/poky/meta \
  /home/masr4788/aesd_assignments/A6_2/assignment-6-malolasimman/poky/meta-poky \
  /home/masr4788/aesd_assignments/A6_2/assignment-6-malolasimman/poky/meta-yocto-bsp \
  "
```
